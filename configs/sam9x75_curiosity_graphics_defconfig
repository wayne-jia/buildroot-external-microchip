## configs/sam9x75_curiosity_graphics_defconfig
```kconfig
BR2_arm=y
BR2_TOOLCHAIN_BUILDROOT_CXX=y
BR2_CCACHE=y
BR2_OPTIMIZE_FAST=y
BR2_GLOBAL_PATCH_DIR="$(BR2_EXTERNAL_MCHP_PATH)/patches"
BR2_TARGET_GENERIC_HOSTNAME="sam9x75_curiosity"
BR2_TARGET_GENERIC_ISSUE="Welcome to the Microchip SAM9X75 Curiosity Board Demo"
BR2_ROOTFS_DEVICE_CREATION_DYNAMIC_EUDEV=y
BR2_ROOTFS_DEVICE_TABLE="$(BR2_EXTERNAL_MCHP_PATH)/system/device_table.txt"
BR2_ROOTFS_MERGED_USR=y
BR2_SYSTEM_DEFAULT_PATH="/bin:/sbin:/usr/bin:/usr/sbin"
# BR2_ENABLE_LOCALE_PURGE is not set
BR2_ROOTFS_OVERLAY="$(BR2_EXTERNAL_MCHP_PATH)/board/microchip/sam9x75_curiosity/fs-overlay/"
BR2_ROOTFS_POST_BUILD_SCRIPT="$(BR2_EXTERNAL_MCHP_PATH)/board/microchip/at91/post_build.sh $(BR2_EXTERNAL_MCHP_PATH)/board/microchip/sam9x/post_build.sh"
BR2_ROOTFS_POST_IMAGE_SCRIPT="support/scripts/genimage.sh"
BR2_ROOTFS_POST_SCRIPT_ARGS="-c $(BR2_EXTERNAL_MCHP_PATH)/board/microchip/sam9x75_curiosity/genimage.cfg"
BR2_LINUX_KERNEL=y
BR2_LINUX_KERNEL_CUSTOM_TARBALL=y
BR2_LINUX_KERNEL_CUSTOM_TARBALL_LOCATION="$(call github,linux4microchip,linux,linux4microchip-2024.04-rc5)/linux-linux4microchip-2024.04-rc5.tar.gz"
BR2_LINUX_KERNEL_USE_CUSTOM_CONFIG=y
BR2_LINUX_KERNEL_CUSTOM_CONFIG_FILE="$(BR2_EXTERNAL_MCHP_PATH)/board/microchip/sam9x75_curiosity/linux.config"
BR2_LINUX_KERNEL_DTS_SUPPORT=y
BR2_LINUX_KERNEL_INTREE_DTS_NAME="microchip/at91-sam9x75_curiosity"
# BR2_PACKAGE_EUDEV_ENABLE_HWDB is not set
# BR2_PACKAGE_LUA_32BITS is not set
# BR2_PACKAGE_LUA_CVT_N2S is not set
# BR2_PACKAGE_LUA_CVT_S2N is not set
BR2_PACKAGE_ZLIB=y
BR2_PACKAGE_LIBDRM_INSTALL_TESTS=y
BR2_PACKAGE_LIBINPUT=y
# BR2_PACKAGE_IFUPDOWN_SCRIPTS is not set
# BR2_PACKAGE_URANDOM_SCRIPTS is not set
BR2_PACKAGE_UTIL_LINUX_AGETTY=y
BR2_PACKAGE_UTIL_LINUX_MOUNT=y
BR2_TARGET_ROOTFS_EXT2=y
BR2_TARGET_ROOTFS_EXT2_4=y
BR2_TARGET_ROOTFS_EXT2_LABEL="ROOTFS"
BR2_TARGET_ROOTFS_EXT2_SIZE="43m"
BR2_TARGET_ROOTFS_EXT2_INODE_SIZE=0
BR2_TARGET_ROOTFS_EXT2_MKFS_OPTIONS="-O 64bit"
BR2_TARGET_AT91BOOTSTRAP3=y
BR2_TARGET_AT91BOOTSTRAP3_CUSTOM_GIT=y
BR2_TARGET_AT91BOOTSTRAP3_CUSTOM_REPO_URL="https://github.com/MCHP-MPU-Solutions-SHA/at91bootstrap.git"
BR2_TARGET_AT91BOOTSTRAP3_CUSTOM_REPO_VERSION="9x75cu_ws4round_fb_1.0"
BR2_TARGET_AT91BOOTSTRAP3_DEFCONFIG="sam9x75cusd_linux_image_dt_fastboot"
BR2_PACKAGE_HOST_DTC=y
BR2_PACKAGE_HOST_GENIMAGE=y
BR2_PACKAGE_LIBPLANES=y
# BR2_PACKAGE_LIBPLANES_INSTALL_EXAMPLES is not set
BR2_PACKAGE_EGT=y
# BR2_PACKAGE_EGT_MEDIA_SUPPORT is not set
# BR2_PACKAGE_EGT_CHART_SUPPORT is not set
# BR2_PACKAGE_EGT_SVG_SUPPORT is not set
# BR2_PACKAGE_EGT_INSTALL_EXAMPLES is not set
# BR2_PACKAGE_EGT_INSTALL_ICONS is not set
BR2_PACKAGE_EGT_EXTRA_CONFIG_OPTIONS="--without-readline --without-filesystem --without-librsvg --without-lua --without-plplot --without-libcurl --without-libinput --without-x11 --without-xkbcommon"
BR2_PACKAGE_NOTO_FONTS=y
BR2_PACKAGE_NOTO_FONTS_FONTS="NotoSans-Regular.ttf NotoSans-BoldItalic.ttf NotoSansCJKtc-Regular.otf"
```
